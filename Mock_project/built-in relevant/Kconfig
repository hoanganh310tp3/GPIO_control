## Mock_project/built-in relevant/Kconfig
```kconfig
menu "My Custom Drivers"

config LED_DRIVER
    bool "LED GPIO Driver"
    default y
    help
      Enables a GPIO LED platform driver.

config BUTTON_DRIVER
    bool "Button GPIO Driver"
    default y
    help
      Enables a GPIO Button platform driver.

endmenu
```
